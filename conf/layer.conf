## conf/layer.conf
```bitbake
# We have a conf and classes directory, add to BBPATH
BBPATH .= ":${LAYERDIR}"

# We have recipes-* directories, add to BBFILES
BBFILES += "${LAYERDIR}/recipes-*/*/*.bb \
	${LAYERDIR}/recipes-*/*/*.bbappend"

BBFILE_COLLECTIONS += "imx6qtibidabo"
BBFILE_PATTERN_imx6qtibidabo = "^${LAYERDIR}/"
BBFILE_PRIORITY_imx6qtibidabo = "6"
```

## conf/machine/imx6q_tibidabo.conf
```bitbake
#@TYPE: Machine
#@NAME: Freescale i.MX6Q Tibidabo board
#@SOC: i.MX6Q
#@DESCRIPTION: Machine configuration for ArchiTech Tibidabo board
#@MAINTAINER: Fausto Sessego <fausto.sessego@infomob.it>

require conf/machine/include/imx6tibidabo-common.inc

SOC_FAMILY = "mx6:mx6q"

KERNEL_DEVICETREE = "imx6q-tibidabo.dtb imx6q-tibidabo-ldo.dtb imx6q-tibidabo-hdcp.dtb \
                     imx6q-tibidabo-enetirq.dtb imx6q-tibidabo-uart.dtb"

UBOOT_CONFIG ??= "sd"
UBOOT_CONFIG[sd] = "mx6qtibidabo_config,sdcard"
UBOOT_CONFIG[sata] = "mx6qtibidabo_sata_config"
UBOOT_CONFIG[mfgtool] = "mx6qtibidabo_config"
```
